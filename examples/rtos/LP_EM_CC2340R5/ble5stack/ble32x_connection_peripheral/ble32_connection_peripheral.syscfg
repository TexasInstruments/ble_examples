/**
 * @cliArgs --board "/ti/boards/LP_EM_CC2340R5" --rtos "freertos" --product "simplelink_lowpower_f3_sdk@7.40.00.64"
 * @versions {"tool":"1.18.1+3343"}
 */

/**
 * Import the modules used in this configuration.
 */
const FreeRTOS    = scripting.addModule("/freertos/FreeRTOS");
const ble         = scripting.addModule("/ti/ble5stack/ble");
const CCFG        = scripting.addModule("/ti/devices/CCFG");
const rfdesign    = scripting.addModule("/ti/devices/radioconfig/rfdesign");
const Display     = scripting.addModule("/ti/display/Display");
const Display1    = Display.addInstance();
const AESCCM      = scripting.addModule("/ti/drivers/AESCCM");
const AESCCM1     = AESCCM.addInstance();
const AESCTRDRBG  = scripting.addModule("/ti/drivers/AESCTRDRBG");
const AESCTRDRBG1 = AESCTRDRBG.addInstance();
const AESECB      = scripting.addModule("/ti/drivers/AESECB");
const AESECB1     = AESECB.addInstance();
const ECDH        = scripting.addModule("/ti/drivers/ECDH");
const ECDH1       = ECDH.addInstance();
const GPIO        = scripting.addModule("/ti/drivers/GPIO");
const GPIO5       = GPIO.addInstance();
const GPIO6       = GPIO.addInstance();
const NVS         = scripting.addModule("/ti/drivers/NVS");
const NVS1        = NVS.addInstance();
const Power       = scripting.addModule("/ti/drivers/Power");
const RCL         = scripting.addModule("/ti/drivers/RCL");
const RNG         = scripting.addModule("/ti/drivers/RNG");
const RNG1        = RNG.addInstance();
const Button      = scripting.addModule("/ti/drivers/apps/Button", {}, false);
const Button1     = Button.addInstance();
const Button2     = Button.addInstance();
const Settings    = scripting.addModule("/ti/posix/freertos/Settings");

/**
 * Write custom configuration values to the imported modules.
 */
FreeRTOS.heapSize       = 0x00005000;
FreeRTOS.timerStackSize = 0x00000190;
FreeRTOS.idleStackSize  = 0x00000130;

ble.basicBLE                                                   = true;
ble.disDevBySerUuid                                            = true;
ble.numOfAdvSets                                               = 1;
ble.numOfDefAdvSets                                            = 1;
ble.deviceName                                                 = "Data Stream";
ble.maxNumPrepareWrites                                        = 10;
ble.maxPDUSize                                                 = 255;
ble.addressMode                                                = "ADDRMODE_PUBLIC";
ble.bondPairing                                                = "GAPBOND_PAIRING_MODE_NO_PAIRING";
ble.bondMITMProtection                                         = false;
ble.bonding                                                    = false;
ble.extendedStackSettings                                      = "CENTRAL_GUARD_TIME_ENABLE";
ble.paramUpdateReq                                             = "GAP_UPDATE_REQ_ACCEPT_ALL";
ble.sendParamsUpdateReq                                        = false;
ble.radioConfig.codeExportConfig.$name                         = "ti_devices_radioconfig_code_export_param0";
ble.advSet1.$name                                              = "ti_ble5stack_broadcaster_advertisement_set0";
ble.advSet1.advParam1.$name                                    = "ti_ble5stack_broadcaster_advertisement_params0";
ble.advSet1.advParam1.primIntMin                               = 20;
ble.advSet1.advParam1.primIntMax                               = 40;
ble.advSet1.advData1.$name                                     = "ti_ble5stack_broadcaster_advertisement_data0";
ble.advSet1.advData1.numOfUUIDs16More                          = 1;
ble.advSet1.advData1.UUID016More                               = 0xFFF0;
ble.advSet1.advData1.GAP_ADTYPE_128BIT_MORE                    = true;
ble.advSet1.advData1.numOfUUIDs128More                         = 1;
ble.advSet1.advData1.UUID0128More                              = system.utils.bigInt("B000405104C0C000F0",16);
ble.advSet1.advData1.GAP_ADTYPE_MANUFACTURER_SPECIFIC          = true;
ble.advSet1.advData1.additionalData                            = "0xC0FFEE";
ble.advSet1.scanRes1.$name                                     = "ti_ble5stack_broadcaster_advertisement_data1";
ble.advSet1.scanRes1.GAP_ADTYPE_PERIPHERAL_CONN_INTERVAL_RANGE = true;

CCFG.ccfgTemplate.$name = "ti_devices_CCFG_CCFGCC23X0Template0";

Display1.$name                                 = "CONFIG_Display_0";
Display1.$hardware                             = system.deviceData.board.components.XDS110UART;
Display1.enableANSI                            = true;
Display1.uartBufferSize                        = 128;
Display1.uart.$name                            = "CONFIG_DISPLAY_UART";
Display1.uart.txPinInstance.initialOutputState = "High";
Display1.uart.txPinInstance.$name              = "CONFIG_PIN_UART_TX";
Display1.uart.rxPinInstance.$name              = "CONFIG_PIN_UART_RX";

AESCCM1.$name = "CONFIG_AESCCM0";

AESCTRDRBG1.$name = "CONFIG_AESCTRDRBG_0";

AESECB1.$name = "CONFIG_AESECB0";

ECDH1.$name = "CONFIG_ECDH0";

GPIO5.$hardware = system.deviceData.board.components.LED_GREEN;
GPIO5.$name     = "CONFIG_GPIO_LED_GREEN";

GPIO6.$hardware = system.deviceData.board.components.LED_RED;
GPIO6.$name     = "CONFIG_GPIO_LED_RED";

NVS1.$name                    = "CONFIG_NVSINTERNAL";
NVS1.internalFlash.$name      = "ti_drivers_nvs_NVSLPF30";
NVS1.internalFlash.regionBase = 0x7C000;
NVS1.internalFlash.regionSize = 0x4000;

RNG1.$name = "CONFIG_RNG_0";

Button1.$name     = "CONFIG_BUTTON_0";
Button1.$hardware = system.deviceData.board.components["BTN-1"];

Button2.$name     = "CONFIG_BUTTON_1";
Button2.$hardware = system.deviceData.board.components["BTN-2"];

/**
 * Pinmux solution for unlocked pins/peripherals. This ensures that minor changes to the automatic solver in a future
 * version of the tool will not impact the pinmux you originally saw.  These lines can be completely deleted in order to
 * re-solve from scratch.
 */
Display1.uart.uart.$suggestSolution              = "UART0";
Display1.uart.uart.dmaTxChannel.$suggestSolution = "DMA_CH1";
Display1.uart.uart.dmaRxChannel.$suggestSolution = "DMA_CH0";
Display1.uart.uart.txPin.$suggestSolution        = "boosterpack.4";
Display1.uart.uart.rxPin.$suggestSolution        = "boosterpack.3";
GPIO5.gpioPin.$suggestSolution                   = "boosterpack.40";
GPIO6.gpioPin.$suggestSolution                   = "boosterpack.39";
Button1.button.$suggestSolution                  = "boosterpack.13";
Button2.button.$suggestSolution                  = "boosterpack.12";
